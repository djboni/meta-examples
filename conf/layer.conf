## conf/layer.conf
```bitbake
BBPATH .= ":${LAYERDIR}"
BBFILES += "${LAYERDIR}/*/*.bb \
            ${LAYERDIR}/*/*.bbappend"
BBFILE_COLLECTIONS += "metaexamples"
BBFILE_PATTERN_metaexamples = "^${LAYERDIR}/"
BBFILE_PRIORITY_metaexamples = "5"
LAYERVERSION_metaexamples = "4"
LAYERSERIES_COMPAT_metaexamples = "kirkstone"
```
